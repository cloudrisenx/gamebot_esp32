#include "games.h"
#include "lang.h"
#include "power.h"
#include <Adafruit_SSD1306.h>
#include "buttons.h"
#include "settings.h"
#include "screen.h"
#include "game_breakout.h"
#include "game_duel.h"
#include "game_ttt.h"
#include "game_dino.h"
#include "game_hitung.h"
#include "game_pong.h"
#include "game_flappy.h"

extern Adafruit_SSD1306 display;

struct GameDef {
  const char *name;
  GameId id;
  bool portrait;
  void (*enter)();
  bool (*update)(bool);
  void (*resume)();
  bool (*isPlaying)();
};

static const GameDef GAMES[] = {
  {"Breakout", GAME_BREAKOUT, false, breakout_enter, breakout_update, breakout_resume, breakout_isPlaying},
  {"Duel", GAME_DUEL, false, duel_enter, duel_update, duel_resume, duel_isPlaying},
  {"Dino Run", GAME_DINO, false, dino_enter, dino_update, dino_resume, dino_isPlaying},
  {"Hitung", GAME_HITUNG, false, hitung_enter, hitung_update, hitung_resume, hitung_isPlaying},
  {"Flappy", GAME_FLAPPY, false, flappy_enter, flappy_update, flappy_resume, flappy_isPlaying},
  {"Pong", GAME_PONG, false, pong_enter, pong_update, pong_resume, pong_isPlaying},
  {"XO", GAME_TTT, false, ttt_enter, ttt_update, ttt_resume, ttt_isPlaying},
};
static const int GAME_LIST_COUNT = sizeof(GAMES) / sizeof(GAMES[0]);

// Ikon carousel 32x32, urutan sama dengan GAMES
static const uint8_t PROGMEM ICON_GAME_BREAKOUT[] = {
  0x00, 0x00, 0x00, 0x00, 0x00, 0x00, 0x00, 0x00, 0x00, 0x00, 0x00, 0x00, 0x3F, 0x7E, 0xFD, 0xF8,
  0x3F, 0x7E, 0xFD, 0xF8, 0x3F, 0x7E, 0xFD, 0xF8, 0x3F, 0x7E, 0xFD, 0xF8, 0x00, 0x00, 0x00, 0x00,
  0x3F, 0x7E, 0xFD, 0xF8, 0x3F, 0x7E, 0xFD, 0xF8, 0x3F, 0x7E, 0xFD, 0xF8, 0x3F, 0x7E, 0xFD, 0xF8,
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  0x00, 0xFF, 0xFC, 0x00, 0x00, 0xFF, 0xFC, 0x00, 0x00, 0x00, 0x00, 0x00, 0x00, 0x00, 0x00, 0x00,
};
static const uint8_t PROGMEM ICON_GAME_DUEL[] = {
  0x00, 0x00, 0x00, 0x00, 0x00, 0x00, 0x00, 0x00, 0x00, 0x00, 0x00, 0x00, 0x00, 0x00, 0x00, 0x00,
  0x00, 0x01, 0x80, 0x00, 0x00, 0x01, 0x80, 0x00, 0x00, 0x01, 0x80, 0x00, 0x00, 0x01, 0x80, 0x00,
  0x00, 0x01, 0x80, 0x00, 0x7F, 0xF1, 0x8F, 0xFE, 0x7F, 0xF1, 0x8F, 0xFE, 0x7F, 0xF1, 0x8F, 0xFE,
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  0x7F, 0xFF, 0xFF, 0xFE, 0x7F, 0xFF, 0xFF, 0xFE, 0x00, 0x00, 0x00, 0x00, 0x00, 0x00, 0x00, 0x00,
};
static const uint8_t PROGMEM ICON_GAME_TTT[] = {
  0x00, 0x00, 0x00, 0x00, 0x00, 0x98, 0x06, 0x70, 0x11, 0xD8, 0x07, 0xFC, 0x3B, 0x98, 0x07, 0x8C,
  0x1F, 0x18, 0x07, 0x06, 0x0E, 0x18, 0x07, 0x06, 0x1F, 0x18, 0x07, 0x06, 0x3B, 0x98, 0x07, 0x8C,
  0x11, 0xD8, 0x07, 0xFC, 0x00, 0x98, 0x06, 0x70, 0x00, 0x18, 0x06, 0x00, 0x7F, 0xFF, 0xFF, 0xFE,
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  0x31, 0x98, 0x06, 0x00, 0x3F, 0x98, 0x06, 0x00, 0x0E, 0x18, 0x06, 0x00, 0x00, 0x00, 0x00, 0x00,
};
static const uint8_t PROGMEM ICON_GAME_DINO[] = {
  0x00, 0x00, 0x00, 0x00, 0x00, 0x00, 0x00, 0x00, 0x00, 0x00, 0x00, 0x00, 0x00, 0x00, 0xFF, 0xF8,
  0x00, 0x00, 0xFF, 0xF8, 0x00, 0x00, 0xE7, 0xF8, 0x00, 0x00, 0xE7, 0xF8, 0x00, 0x00, 0xFF, 0xF8,
  0x00, 0x00, 0xFF, 0xF8, 0x00, 0x00, 0xFF, 0xF8, 0x00, 0x00, 0xFF, 0xE0, 0x00, 0x03, 0xFE, 0x00,
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  0x00, 0x01, 0xEF, 0x00, 0x00, 0x00, 0x00, 0x00, 0xFF, 0xFF, 0xFF, 0xFF, 0x00, 0x00, 0x00, 0x00,
};
static const uint8_t PROGMEM ICON_GAME_HITUNG[] = {
  0x00, 0x00, 0x00, 0x00, 0x00, 0x00, 0x00, 0x20, 0x04, 0x40, 0x78, 0x20, 0x0E, 0xE0, 0xFC, 0x70,
  0x1F, 0xF1, 0xFE, 0x70, 0x3F, 0xF9, 0xFE, 0xF8, 0x1F, 0xF1, 0xFF, 0xFF, 0x0F, 0xE1, 0xFF, 0xFE,
  0x07, 0xC0, 0xFF, 0xFE, 0x07, 0xC0, 0x79, 0xFC, 0x03, 0x80, 0x01, 0xFC, 0x01, 0x00, 0x01, 0xFC,
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  0x00, 0x00, 0x00, 0x00, 0x00, 0x00, 0x00, 0x30, 0x3F, 0xFF, 0xE0, 0x30, 0x00, 0x00, 0x00, 0x00,
};
static const uint8_t PROGMEM ICON_GAME_FLAPPY[] = {
  0x00, 0x00, 0x00, 0x00, 0x00, 0x00, 0x00, 0x00, 0x00, 0x00, 0x00, 0x00, 0x00, 0x00, 0x00, 0x00,
  0x00, 0x00, 0x00, 0x00, 0x00, 0x00, 0x00, 0x00, 0x00, 0x00, 0x00, 0x00, 0x00, 0x00, 0x00, 0x00,
  0x00, 0x0F, 0xE0, 0x00, 0x00, 0x3F, 0xF8, 0x00, 0x00, 0xF0, 0x7E, 0x00, 0x01, 0xC0, 0xFF, 0x00,
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  0x00, 0x00, 0x00, 0x00, 0x00, 0x00, 0x00, 0x00, 0x00, 0x00, 0x00, 0x00, 0x00, 0x00, 0x00, 0x00,
};
static const uint8_t PROGMEM ICON_GAME_PONG[] = {
  0x00, 0x00, 0x00, 0x00, 0x1F, 0xFF, 0xFF, 0xF8, 0x3F, 0xFF, 0xFF, 0xFC, 0x60, 0x00, 0x00, 0x06,
  0x60, 0x7F, 0xFE, 0x06, 0x60, 0x7F, 0xFE, 0x06, 0x60, 0x7F, 0xFE, 0x06, 0x60, 0x00, 0x00, 0x06,
  0x60, 0x00, 0x00, 0x06, 0x60, 0x00, 0x00, 0x06, 0x60, 0x00, 0x38, 0x06, 0x60, 0x00, 0x38, 0x06,
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  0x60, 0x00, 0x00, 0x06, 0x3F, 0xFF, 0xFF, 0xFC, 0x1F, 0xFF, 0xFF, 0xF8, 0x00, 0x00, 0x00, 0x00,
};
static const uint8_t *const GAME_ICONS[] = {ICON_GAME_BREAKOUT, ICON_GAME_DUEL, ICON_GAME_DINO, ICON_GAME_HITUNG,
                                            ICON_GAME_FLAPPY, ICON_GAME_PONG, ICON_GAME_TTT};
static_assert(sizeof(GAME_ICONS) / sizeof(GAME_ICONS[0]) == GAME_LIST_COUNT, "ikon per game");

static Carousel car = {};
static int active = -1;

static void drawList() {
  // Header tengah: hi-score game yang dipilih ("Hi" pendek agar tidak menabrak status BT di kanan)
  char best[16];
  snprintf(best, sizeof(best), "Hi %u", (unsigned)settings_hiscore(GAMES[car.sel].id));
  carousel_draw(car, best, GAME_ICONS, GAME_LIST_COUNT, !strcmp(GAMES[car.sel].name, "Hitung") ? T("Hitung", "Math") : GAMES[car.sel].name);
  oled_flush();
}

void games_enter() {
  active = -1;
  screen_landscape();
}

AppState games_update(bool redraw) {
  if (active >= 0) {
    if (GAMES[active].update(redraw)) return ST_GAME;
    // BACK di dalam game: kembali ke daftar
    active = -1;
    screen_landscape();
    buttons_clear();
    drawList();
    return ST_GAME;
  }

  if (btn_pressed(BTN_BACK)) return ST_MENU;
  if (carousel_input(car, GAME_LIST_COUNT)) { marquee_reset(); redraw = true; }
  if (carousel_frameDue(car) || marquee_frameDue()) redraw = true;
  if (btn_pressed(BTN_OK)) {
    active = car.sel;
    if (GAMES[active].portrait) screen_portrait();
    buttons_clear();
    GAMES[active].enter();
    GAMES[active].update(true);
    return ST_GAME;
  }
  if (redraw) drawList();
  return ST_GAME;
}

void games_resume() {
  if (active < 0) return;
  if (GAMES[active].portrait) screen_portrait();
  GAMES[active].resume();
}

bool games_isPlaying() { return active >= 0 && GAMES[active].isPlaying(); }

// ---------------- Helper bersama ----------------

void games_centerText(int y, const String &s) {
  display.setCursor((display.width() - (int)s.length() * 6) / 2, y);
  display.print(s);
}

void games_drawReady(const char *title, const char *const *controls, int count, uint32_t best) {
  bool portrait = display.width() < display.height();
  display.clearDisplay();
  display.setTextSize(1);
  display.setTextColor(SSD1306_WHITE);
  int y;
  if (portrait) {
    games_centerText(4, title);
    games_centerText(20, T("Putar", "Rotate"));
    games_centerText(29, T("layar", "screen"));
    // Panah putar: 3/4 lingkaran + kepala panah
    display.drawCircleHelper(32, 48, 7, 0x1 | 0x2 | 0x4, SSD1306_WHITE);
    display.fillTriangle(31, 52, 31, 58, 27, 55, SSD1306_WHITE);
    y = 66;
  } else {
    games_centerText(2, title);
    y = 15;
  }
  for (int i = 0; i < count; i++, y += 9) games_centerText(y, controls[i]);
  y += portrait ? 6 : 2;
  games_centerText(y, "Best " + String(best));
  games_centerText(display.height() - 10, T("OK: mulai", "OK: start"));
  oled_flush();
}

void games_drawOver(uint32_t score, uint32_t best) {
  bool portrait = display.width() < display.height();
  int bw = portrait ? 62 : 100;
  int bh = 50;
  int x = (display.width() - bw) / 2;
  int y = (display.height() - bh) / 2;
  display.fillRect(x, y, bw, bh, SSD1306_BLACK);
  display.drawRect(x, y, bw, bh, SSD1306_WHITE);
  display.setTextSize(1);
  display.setTextColor(SSD1306_WHITE);
  games_centerText(y + 4, "GAME OVER");
  games_centerText(y + 14, T("Skor ", "Score ") + String(score));
  games_centerText(y + 23, "Best " + String(best));
  games_centerText(y + 32, T("OK:ulang", "OK:again"));
  // Lebar potret hanya 10 karakter
  games_centerText(y + 41, portrait ? T("BACK:balik", "BACK:back") : T("BACK:keluar", "BACK:exit"));
}

void games_drawLives(int lives) {
  for (int i = 0; i < lives; i++) display.fillRect(display.width() - 3 - i * 4, 2, 2, 2, SSD1306_WHITE);
}

// Angka maks 4 karakter (24 px, ada jarak ke bingkai): 12345 -> "12k", 1234567 -> "1M"
static void printShort(int x, int y, uint32_t v) {
  char buf[8];
  if (v < 10000) snprintf(buf, sizeof(buf), "%u", (unsigned)v);
  else if (v < 1000000) snprintf(buf, sizeof(buf), "%uk", (unsigned)(v / 1000));
  else snprintf(buf, sizeof(buf), "%uM", (unsigned)(v / 1000000));
  display.setCursor(x, y);
  display.print(buf);
}

// Hiasan statis: deret bintik ala layar arcade di bawah panel
static void panelDots(int x0, int x1, int y0, int y1) {
  for (int y = y0; y <= y1; y += 4)
    for (int x = x0 + ((y / 4) & 1) * 2; x <= x1; x += 4) display.drawPixel(x, y, SSD1306_WHITE);
}

void games_drawSidePanels(uint32_t score, uint32_t hi, int lives, int level) {
  const int left = FIELD_X0 - 1, right = FIELD_X0 + FIELD_W;  // tepi luar area main
  display.fillRect(0, 0, left + 1, 64, SSD1306_BLACK);           // panel menutupi sisa objek di luar area
  display.fillRect(right, 0, 128 - right, 64, SSD1306_BLACK);
  // Bingkai garis ganda (garis, celah 1 px, garis)
  display.drawFastVLine(left - 2, 0, 64, SSD1306_WHITE);
  display.drawFastVLine(left, 0, 64, SSD1306_WHITE);
  display.drawFastVLine(right, 0, 64, SSD1306_WHITE);
  display.drawFastVLine(right + 2, 0, 64, SSD1306_WHITE);
  display.setTextSize(1);
  display.setTextColor(SSD1306_WHITE);
  display.setTextWrap(false);
  // Kiri: SCORE / HI (x 0..28)
  display.setCursor(0, 2); display.print(T("SKOR", "PTS"));
  printShort(0, 12, score);
  display.drawFastHLine(0, 22, left - 3, SSD1306_WHITE);
  display.setCursor(0, 26); display.print("HI");
  printShort(0, 36, hi);
  panelDots(1, left - 4, 48, 62);
  // Kanan: LIVES / LV (x right+4 .. 127)
  int rx = right + 4;
  display.setCursor(rx, 2); display.print("LIFE");
  for (int i = 0; i < lives && i < 5; i++) display.fillRect(rx + i * 5, 13, 3, 3, SSD1306_WHITE);
  display.drawFastHLine(rx, 22, 127 - rx, SSD1306_WHITE);
  display.setCursor(rx, 26); display.print("LV");
  printShort(rx, 36, level);
  panelDots(rx + 1, 126, 48, 62);
  display.setTextWrap(true);
}
